
#include <WiFi.h>
#include <ArduinoHttpClient.h>
#include <ArduinoJson.h>
#include <Ds1302.h>
#include "DFRobotDFPlayerMini.h"

// display matrix
#include <MD_Parola.h>
#include <MD_MAX72xx.h>
#include <SPI.h>

#define HARDWARE_TYPE MD_MAX72XX::FC16_HW
#define MAX_DEVICES 4

#define CLK_PIN 3
#define DATA_PIN 5
#define CS_PIN 4

// oled
#include <Adafruit_SSD1306.h>
#include <Adafruit_GFX.h>
#include <SPI.h>

#include <OneButton.h>

#define BUTTON_PIN 6 // Pin, na kterém je připojeno tlačítko

OneButton button(BUTTON_PIN, true); // Vytvoření instance tlačítka s aktivním pull-up rezistorem

bool singleClickDetected = false;
bool doubleClickDetected = false;
bool Menus[2] = {true, true};
String Budik = "";
// nastavení propojovacích pinů modulu
 #define pinX A2
 #define pinY A3
 #define pinKey 6
// proměnné pro uložení hodnoty
// středu joysticku
 int nulaX, nulaY;



// Hardware SPI connection
// MD_Parola P = MD_Parola(HARDWARE_TYPE, CS_PIN, MAX_DEVICES);
// Arbitrary output pins
MD_Parola P = MD_Parola(HARDWARE_TYPE, DATA_PIN, CLK_PIN, CS_PIN, MAX_DEVICES);

// WiFi promenne
char ssid[] = "MujO2Internet_33D5C2";
char pass[] = "FAakfTjY";
int status = 0;
WiFiClient client;

// Json promenne
StaticJsonDocument<256> timeApi;
StaticJsonDocument<768> temp;
HttpClient httpClientTime = HttpClient(client, "www.worldtimeapi.org", 80);
HttpClient httpClientWeather = HttpClient(client, "api.openweathermap.org", 80);

// vytvoreni RTC klasy
////// DS1302 RTC instance rst data clk
Ds1302 rtc(22, 24, 26);
const static char *WeekDays[] =
    {
        "Monday",
        "Tuesday",
        "Wednesday",
        "Thursday",
        "Friday",
        "Saturday",
        "Sunday"};

// Prehravac
DFRobotDFPlayerMini myDFPlayer;

String Barvy = "";

// promenne pro delay
int timeTime = 30001;
int timeTemp = 30001;
int timeUkazatel = 30001;
int timeUkazatelCasu = 30001;

// Knihovny
#include <LiquidCrystal_I2C.h>
#include <BH1750.h>
// #include <Ethernet2.h>
// Teploměr a vlhkoměr DHT11
#include "MQ135.h"
// připojení knihovny DHT
#include "DHT.h"
#include <Wire.h>

// nastavení čísla pinu s připojeným DHT senzorem
#define pinDHT1 2
#define analogPin A1
#define pinA A0
#define pinD 4
#define typDHT11 DHT11

LiquidCrystal_I2C lcd(0x27, 20, 4);
BH1750 luxSenzor;
MQ135 senzorMQ = MQ135(pinA);
DHT DHT1(pinDHT1, typDHT11);

// EthernetServer server(80);

    int pozice = 0;



// Oled widgety
const unsigned char thunderstorm_rain[] PROGMEM = {
    0xff, 0xff, 0xff, 0xff, 0xff, 0xff, 0xff, 0xf0, 0xff, 0xff, 0xff, 0xff, 0xff, 0xff, 0xff, 0xf0,
    0xff, 0xff, 0xff, 0xff, 0xff, 0xff, 0xff, 0xf0, 0xff, 0xff, 0xff, 0xff, 0xff, 0xff, 0xff, 0xf0,
    0xff, 0xff, 0xff, 0xff, 0xff, 0x3f, 0xff, 0xf0, 0xff, 0xff, 0xff, 0xff, 0xef, 0x1f, 0xff, 0xf0,
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    0xff, 0xff, 0xff, 0xff, 0xff, 0xff, 0xff, 0xf0};
const unsigned char cloudy[] PROGMEM = {
    // 'cloudy', 60x53px
    0xff, 0xff, 0xff, 0xff, 0xff, 0xff, 0xff, 0xf0, 0xff, 0xff, 0xff, 0xff, 0xff, 0xff, 0xff, 0xf0,
    0xff, 0xff, 0xff, 0xff, 0xff, 0xff, 0xff, 0xf0, 0xff, 0xff, 0xff, 0xff, 0xff, 0xff, 0xff, 0xf0,
    0xff, 0xff, 0xff, 0xff, 0xff, 0xff, 0xff, 0xf0, 0xff, 0xff, 0xff, 0xfe, 0x07, 0xff, 0xff, 0xf0,
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    0xff, 0xff, 0xff, 0xff, 0xff, 0xff, 0xff, 0xf0};
const unsigned char drizzle[] PROGMEM = {
    // 'drizzle', 59x55px
    0xff, 0xff, 0xff, 0xff, 0xff, 0xff, 0xff, 0xe0, 0xff, 0xff, 0xff, 0xff, 0xff, 0xff, 0xff, 0xe0,
    0xff, 0xff, 0xff, 0xff, 0xff, 0xff, 0xff, 0xe0, 0xff, 0xff, 0xfc, 0x01, 0xff, 0xff, 0xff, 0xe0,
    0xff, 0xff, 0xf8, 0x00, 0x3f, 0xff, 0xff, 0xe0, 0xff, 0xff, 0xc0, 0x00, 0x07, 0xff, 0xff, 0xe0,
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    0xff, 0xff, 0xff, 0xff, 0xff, 0xff, 0xff, 0xe0};
const unsigned char mist[] PROGMEM = {
    // 'mist', 59x54px
    0xff, 0xff, 0xff, 0xff, 0xff, 0xff, 0xff, 0xe0, 0xff, 0xff, 0xff, 0xff, 0xff, 0xff, 0xff, 0xe0,
    0xff, 0xff, 0xff, 0xff, 0xff, 0xff, 0xff, 0xe0, 0xff, 0xff, 0xff, 0xff, 0xff, 0xff, 0xff, 0xe0,
    0xff, 0xff, 0xff, 0xff, 0xff, 0xff, 0xff, 0xe0, 0xff, 0xff, 0xff, 0xff, 0xff, 0xff, 0xff, 0xe0,
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    0xff, 0xff, 0xff, 0xff, 0xff, 0xff, 0xff, 0xe0, 0xff, 0xff, 0xff, 0xff, 0xff, 0xff, 0xff, 0xe0};
const unsigned char rain[] PROGMEM = {
    // 'rain', 59x55px
    0xff, 0xff, 0xff, 0xff, 0xff, 0xff, 0xff, 0xe0, 0xff, 0xff, 0xff, 0xff, 0xff, 0xff, 0xff, 0xe0,
    0xff, 0xff, 0xff, 0xc0, 0x3f, 0xff, 0xff, 0xe0, 0xff, 0xff, 0xff, 0x00, 0x0f, 0xff, 0xff, 0xe0,
    0xff, 0xff, 0xf8, 0x00, 0x01, 0xff, 0xff, 0xe0, 0xff, 0xff, 0xf0, 0x00, 0x00, 0xff, 0xff, 0xe0,
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    0xff, 0xff, 0xff, 0xff, 0xff, 0xff, 0xff, 0xe0};
const unsigned char sleet[] PROGMEM = {
    // 'sleet', 60x54px
    0xff, 0xff, 0xff, 0xff, 0xff, 0xff, 0xff, 0xf0, 0xff, 0xff, 0xff, 0xff, 0xff, 0xff, 0xff, 0xf0,
    0xff, 0xff, 0xff, 0xff, 0xff, 0xff, 0xff, 0xf0, 0xff, 0xff, 0xff, 0xff, 0xff, 0xff, 0xff, 0xf0,
    0xff, 0xff, 0xff, 0xff, 0xff, 0xff, 0xff, 0xf0, 0xff, 0xff, 0xff, 0xff, 0xff, 0xff, 0xff, 0xf0,
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    0xff, 0xff, 0xff, 0xff, 0xff, 0xff, 0xff, 0xf0, 0xff, 0xff, 0xff, 0xff, 0xff, 0xff, 0xff, 0xf0};
const unsigned char snow[] PROGMEM = {
    // 'snow(1)', 57x58px
    0xff, 0xff, 0xff, 0xf0, 0xff, 0xff, 0xff, 0x80, 0xff, 0xff, 0xff, 0xf0, 0x7f, 0xff, 0xff, 0x80,
    0xff, 0xff, 0xff, 0xe0, 0x7f, 0xff, 0xff, 0x80, 0xff, 0xff, 0xff, 0xe0, 0x3f, 0xff, 0xff, 0x80,
    0xff, 0xff, 0xff, 0xf0, 0x7f, 0xff, 0xff, 0x80, 0xff, 0xff, 0xff, 0xf0, 0x7f, 0xff, 0xff, 0x80,
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    0xff, 0xff, 0xff, 0xf0, 0xff, 0xff, 0xff, 0x80, 0xff, 0xff, 0xff, 0xf9, 0xff, 0xff, 0xff, 0x80};
const unsigned char thunderstrom_drizzle[] PROGMEM = {
    // 'thunderstorm with drizzle', 59x55px
    0xff, 0xff, 0xff, 0xff, 0xff, 0xff, 0xff, 0xe0, 0xff, 0xff, 0xff, 0xff, 0xff, 0xff, 0xff, 0xe0,
    0xff, 0xff, 0xff, 0xff, 0xff, 0xff, 0xff, 0xe0, 0xff, 0xff, 0xff, 0xff, 0xff, 0xff, 0xff, 0xe0,
    0xff, 0xff, 0xff, 0xff, 0xff, 0xff, 0xff, 0xe0, 0xff, 0xff, 0xff, 0xff, 0xff, 0xff, 0xff, 0xe0,
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    0xff, 0xff, 0xf7, 0xff, 0xff, 0xff, 0xff, 0xe0};
const unsigned char unknown_prep[] PROGMEM = {
    // 'unknown prep', 59x54px
    0xff, 0xff, 0xff, 0xff, 0xff, 0xff, 0xff, 0xe0, 0xff, 0xff, 0xff, 0xff, 0xff, 0xff, 0xff, 0xe0,
    0xff, 0xff, 0xff, 0xff, 0xff, 0xff, 0xff, 0xe0, 0xff, 0xff, 0xff, 0xff, 0xff, 0xff, 0xff, 0xe0,
    0xff, 0xff, 0xff, 0xff, 0xff, 0xff, 0xff, 0xe0, 0xff, 0xff, 0xff, 0xff, 0xff, 0xff, 0xff, 0xe0,
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    0xff, 0xff, 0xff, 0xff, 0xff, 0xff, 0xff, 0xe0, 0xff, 0xff, 0xff, 0xff, 0xff, 0xff, 0xff, 0xe0};

Adafruit_SSD1306 display(128, 64, &Wire, -1);
int testing = 0;
// deklarace promenných
//
//
int tep = 0;
int vlh = 0;
int lux = 0;
int ppm = 0;

int data[5];

String cas = "";
// const int buttonPin = 6;
// byte mac[] = {
//     0xDE, 0xAD, 0xBE, 0xEF, 0xFE, 0xED};
// StaticJsonDocument<200> jsonDoc;

void nastavRGB(byte r, byte g, byte b, int cislo)
{
    // vytvoření proměnné pro ukládání barev
    uint32_t barva;
    // načtení barvy do proměnné
    // barva = rgbWS.Color(r, g, b);
    // nastavení barvy pro danou LED diodu,
    // číslo má pořadí od nuly
    // rgbWS.setPixelColor(cislo - 1, barva);
    // aktualizace barev na všech modulech
    // rgbWS.show();
}

float vypocet(int value, int min, int max)
{
    float rozsah = max - min;
    float zaklad = value - min;
    float procenta = zaklad / rozsah;
    return procenta;
}


 void singleClick()
{
     singleClickDetected = true;
     pozice = 0;
     Serial.println("jedno");
 }

 void doubleClick()
{
     doubleClickDetected = true;
     Serial.println("dve");
 }



void setup()
{
    // Initialize serial and wait for port to open:
    Serial.begin(9600);
    Serial2.begin(9600);
    Serial3.begin(9600);
    while (!Serial3)
        ;

    while (!Serial2)
        ;
    while (!Serial)
    {
        ; // wait for serial port to connect. Needed for native USB port only
    }

    // check for the WiFi module:
    if (WiFi.status() == WL_NO_MODULE)
    {
        Serial.println("Communication with WiFi module failed!");
        // don't continue
        while (true)
            ;
    }

    // attempt to connect to WiFi network:
    while (status != WL_CONNECTED)
    {
        Serial.print("Attempting to connect to WPA SSID: ");
        Serial.println(ssid);
        status = WiFi.begin(ssid, pass);
        // Connect to WPA/WPA2 network:
    }

    // you're connected now, so print out the data:
    Serial.print("You're connected to the network");
    Wire.begin();

    // inicializace rtc
    rtc.init();
    // test if clock is halted and set a date-time (see example 2) to start it
    if (rtc.isHalted())
    {
        Serial.println("RTC is halted. Setting time...");

        Ds1302::DateTime dt = {
            .year = 17,
            .month = Ds1302::MONTH_OCT,
            .day = 3,
            .hour = 4,
            .minute = 51,
            .second = 30,
            .dow = Ds1302::DOW_TUE};
        rtc.setDateTime(&dt);
    }

    // mp3 prehravac inicializace
    if (!myDFPlayer.begin(Serial2))
    { // Use softwareSerial to communicate with mp3.
        Serial.println(F("Unable to begin:"));
        Serial.println(F("1.Please recheck the connection!"));
        Serial.println(F("2.Please insert the SD card!"));
        while (true)
            ;
    }
    Serial.println(F("DFPlayer Mini online."));
    //  myDFPlayer.volume(4); // Set volume value. From 0 to 30
    //  myDFPlayer.play(1);   // Play the first mp3
    P.begin();
    P.setSpeed(100);
    display.begin(SSD1306_SWITCHCAPVCC, 0x3C);
    delay(100);
    display.clearDisplay();
    display.setTextColor(WHITE);
    // wait 10 seconds for connection:
    delay(10000);

    lcd.begin();
    lcd.clear();
    lcd.backlight();
    // zapnutí komunikace s teploměrem DHT
    DHT1.begin();
    luxSenzor.begin();
    pinMode(analogPin, INPUT);
    pinMode(A2, OUTPUT);
    // při nástupné hraně (log0->log1) se vykoná program prerus

    myDFPlayer.volume(4); // Set volume value. From 0 to 30
    myDFPlayer.play(1);   // Play the first mp3



 nulaX = analogRead(pinX);
    nulaY = analogRead(pinY);

    button.attachClick(singleClick);
    button.attachDoubleClick(doubleClick);
     JoystickRead();

}
  int aktX, aktY, stavTlac;

void JoystickRead()
{
    // vytvoření proměnných pro uložení
    // hodnot pro osy x, y a stav tlačítka
  
    // načtení analogových hodnot osy x a y
    aktX = analogRead(pinX) - nulaX;
    aktY = analogRead(pinY) - nulaY;
    if (aktX > 0)
    {
        aktX = map(aktX, 0, 1023 - nulaX, 0, 100);
    }
    else
    {
        aktX = map(aktX, 0, -nulaX, 0, -100);
    }
    if (aktY > 0)
    {
        aktY = map(aktY, 0, 1023 - nulaY, 0, 100);
    }
    else
    {
        aktY = map(aktY, 0, -nulaY, 0, -100);
    }
}


int Hlasitost = 5;

void menuDisplay()
{

    lcd.clear();
    lcd.setCursor(1, 0);
    lcd.print("Barvy: " + String(Menus[0]));
    lcd.setCursor(1, 1);
    lcd.print("Bzucak " + String(Menus[1]));
    lcd.setCursor(1, 2);
    lcd.print("Budik: " + Budik);
    lcd.setCursor(1, 3);
    lcd.print("Hlasitost budiku: " + String(Hlasitost));
}


void MainLogicInMenu() {
    unsigned long vykresliMenu = millis();

  while (true) {
    JoystickRead();

    if (aktX < -50) {
      if (pozice >= 3) {
        pozice = 0;
      }
      else {
        pozice++;
      }
      delay(200);
    }

    if (aktX > 50) {
      if (pozice <= 0) {
        pozice = 3;
      }
      else {
        pozice--;
      }
      delay(200);
    }

    if (aktY > 50) {
      if (pozice == 0 || pozice == 1) {
        Menus[pozice] = !Menus[pozice];
      }
      delay(200);
    }

    if (aktY < -50) {
      singleClickDetected = false;
      lcd.clear();
      displayHodnoty();
      delay(200);
      return; // Přidání středníku ";" a odstranění zbytečného delay()
    }

    if ((millis() - vykresliMenu) > 2000) { // Změna na 2000 pro každých 2 sekundy
      menuDisplay();
      lcd.setCursor(0, pozice);
      lcd.cursor();
      lcd.blink();
      vykresliMenu = millis();
    }
  }
  }



void GetTime()
{

    //  myDFPlayer.volume(2); // Set volume value. From 0 to 30
    //  myDFPlayer.play(1);   // Play the first mp3

    httpClientTime.get("/api/timezone/Europe/Prague");
    String payload = httpClientTime.responseBody();
    DeserializationError error = deserializeJson(timeApi, payload.c_str());
    if (error)
    {
        Serial.print(F("deserializeJson() failed: "));
        Serial.println(error.f_str());
        return;
    }
    const char *datetime = timeApi["datetime"]; // "2024-02-09T15:44:57.684805+01:00"
    String datetimeStr = String(datetime);
    int year = datetimeStr.substring(2, 4).toInt();  // "24"
    int month = datetimeStr.substring(5, 7).toInt(); // "02"
    int day = datetimeStr.substring(8, 10).toInt();  // "09"

    int hours = datetimeStr.substring(11, 13).toInt();   // "15"
    int minutes = datetimeStr.substring(14, 16).toInt(); // "44"
    int seconds = datetimeStr.substring(17, 19).toInt(); // "57"
    const char *dow = timeApi["day_of_week"];
    int dowInt = String(dow).toInt(); //
    Ds1302::DateTime dt = {
        .year = year,
        .month = month,
        .day = day,
        .hour = hours,
        .minute = minutes,
        .second = seconds,
        .dow = dowInt + 1};

    rtc.setDateTime(&dt);
    httpClientTime.stop();
}

void GetAndDisplayWeather()
{
    httpClientWeather.get("/data/2.5/weather?lat=49.3039&lon=14.1457&appid=c7751024e682e3d3ed614bf31ae6925f&units=metric&lang=cz");
    String payload = httpClientWeather.responseBody();
    DeserializationError error = deserializeJson(temp, payload);
    if (error)
    {
        Serial.print(F("deserializeJson() failed: "));
        Serial.println(error.f_str());
        return;
    }

    JsonObject weather_0 = temp["weather"][0];
    const char *weather_0_description = weather_0["description"];
    int weather_0_id = weather_0["id"]; // 801
    JsonObject main = temp["main"];
    float main_temp = main["temp"];             // 11.58
    float main_feels_like = main["feels_like"]; // 11.4
    float main_temp_min = main["temp_min"];     // 11.36
    float main_temp_max = main["temp_max"];     // 13.38
    int main_pressure = main["pressure"];       // 994
    int main_humidity = main["humidity"];       // 100
    JsonObject wind = temp["wind"];
    float wind_speed = wind["speed"]; // 3.46
    int wind_deg = wind["deg"];       // 111
    float wind_gust = wind["gust"];   // 9.64
    const char *name = temp["name"];  // "Písek"
    Serial.println(weather_0_description);
    httpClientWeather.stop();
    display.clearDisplay();
    displaywidget(weather_0_id);

    display.setCursor(62, 0);
    display.setTextSize(2);
    testing++;
    display.println(testing);
    display.setTextSize(1);
    display.setCursor(62, 20);
    display.print(name); // Prints city name ie: Marmagao in my case
    display.drawLine(62, 28, 127, 28, WHITE);

    display.setCursor(62, 32);
    display.setTextSize(2);
    display.print(main_temp);
    display.setTextSize(1);
    display.setCursor(62, 48);
    display.print(wind_speed);
    display.print("m/s ");
    display.println(wind_gust);
    display.setCursor(0, 56);
    display.print(weather_0_description);
    display.print("\t");
    display.print("");
    display.startscrollleft(0x07, 0x07);
    display.display();
    delay(10000);
    display.stopscroll();
}


void svitivost(int souradnice)
{
    lux = luxSenzor.readLightLevel();
    lcd.setCursor(0, souradnice);
    lcd.print("Svitivost: ");
    lcd.print(lux);
    lcd.print(" lux");
    Serial.println("svetlo se vykonalo");
    data[0] = lux;
}

void plyny(int souradnice)
{
    // načtení koncentrace plynů v ppm do proměnné
    ppm = senzorMQ.getPPM();
    lcd.setCursor(0, souradnice);
    lcd.print("Konc. CO2: ");
    lcd.print(ppm);
    lcd.print(" ppm");
    Serial.println("plyny se vykonaly");
    data[1] = ppm;
}

void teplota(int souradnice1, int souradnice2)
{
    // inicializace DHT senzoru s nastaveným pinem a typem senzoru
    // pomocí funkcí readTemperature a readHumidity načteme
    // do proměnných tep a vlh informace o teplotě a vlhkosti,
    // čtení trvá cca 250 ms
    tep = DHT1.readTemperature();
    vlh = (DHT1.readHumidity());

    // kontrola, jestli jsou načtené hodnoty čísla pomocí funkce isnan
    if (isnan(tep) || isnan(vlh))
    {
        // při chybném čtení vypiš hlášku
        Serial.println("Chyba při čtení z DHT senzoru!");
    }
    else
    {
        // pokud jsou hodnoty v pořádku,
        // vypiš je po sériové lince
        lcd.setCursor(2, souradnice1); // Move cursor to character 2 on line 1
        lcd.print("Teplota: ");
        lcd.print(tep);
        lcd.print(" ");
        lcd.print((char)223);
        lcd.print("C");
        lcd.setCursor(2, souradnice2);
        lcd.print("Vlhkost: ");
        lcd.print(vlh);
        lcd.print(" %");
        data[2] = tep;
        data[3] = vlh;
    }
    Serial.println("teplo se vykonalo");
}

void ohinek()
{
    int napetiSenzor = analogRead(analogPin);
    // přepočtení celého rozsahu 0-1024 na hodnoty 0-3
    int prepocet = map(napetiSenzor, 0, 1024, 0, 3);
    // nastavení stavu dle hodnoty přepočtené ze vstupu
    switch (prepocet)
    {
    case 0:
        Serial.println("Detekovan ohen ve vzdalenosti do 20 cm!");
        break;
    case 1:
        Serial.println("Detekovan ohen ve vzdalenosti od 20 do 80 cm!");
        break;
    case 2:
        Serial.println("Zadny ohen neni detekovan.");
        break;
    }
    data[4] = prepocet;
}



void displayHodnoty() {
            lcd.clear();

            teplota(0, 1);
            svitivost(2);
            plyny(3);
            ohinek();
            // jsonDoc["svitivost"] = data[0];
            // jsonDoc["plznz"] = data[1];
            // jsonDoc["teplota"] = data[2];
            // jsonDoc["humidity"] = data[3];
            Barvy = "";

            Barvy.concat(255 * vypocet(data[3], 10, 65));
            Barvy.concat(":");
            Barvy.concat(255 * (1 - vypocet(data[3], 10, 65)));
            Barvy.concat(":");
            Barvy.concat(0);
            Barvy.concat(":");
            Barvy.concat(255 * vypocet(data[1], 100, 800));
            Barvy.concat(":");
            Barvy.concat(255 * (1 - vypocet(data[1], 100, 800)));
            Barvy.concat(":");
            Barvy.concat(0);
            Barvy.concat(":");
            Barvy.concat(255 * (1 - vypocet(data[4], 0, 2)));
            Barvy.concat(":");
            Barvy.concat(255 * (vypocet(data[4], 0, 2)));
            Barvy.concat(":");
            Barvy.concat(0);
            Serial3.println(Barvy);
            Serial.println(Barvy);
            if (data[1] > 900 || data[3] > 90 || data[4] != 2)
            {
                analogWrite(A2, 250);
                delay(100);
                analogWrite(A2, 0);
                delay(100);
            }
            //  String jsonString;
            //  serializeJson(jsonDoc, jsonString);
            //  Serial.println(jsonString);
}

void loop()
{
     button.tick(); // Volání metody tick() pro aktualizaci stavu tlačítka
   if (singleClickDetected)
   {
        MainLogicInMenu();
   }
    // check the network connection once every 10 seconds:
    if (status == WL_CONNECTED)
    {
        if (millis() - timeTime > 30000)
        {
            GetTime();
            timeTime = millis();
        }

        if (millis() - timeUkazatelCasu > 30000)
        {
            time();
            timeUkazatelCasu = millis();
        }

        if (millis() - timeTemp > 30000)
        {
            GetAndDisplayWeather();
            timeTemp = millis();
        }

        if ((millis() - timeUkazatel > 30000) && !singleClickDetected)
        {

            displayHodnoty();
            timeUkazatel = millis();
        }
    }
    P.displayAnimate();
}

void time()
{

    Ds1302::DateTime now;
    rtc.getDateTime(&now);
    static uint8_t last_second = 0;
    if (last_second != now.second)
    {
        cas = "";
        last_second = now.second;
        Serial.print("20");
        Serial.print(now.year); // 00-99
        Serial.print('-');
        if (now.month < 10)
            Serial.print('0');
        Serial.print(now.month); // 01-12
        Serial.print('-');
        if (now.day < 10)
            Serial.print('0');
        Serial.print(now.day); // 01-31
        Serial.print(' ');
        Serial.print(WeekDays[now.dow - 1]); // 1-7
        Serial.print(' ');
        if (now.hour < 10)
        {
            Serial.print('0');
            cas.concat(String(0));
        }

        Serial.print(now.hour);
        cas.concat(String(now.hour));
        // 00-23
        Serial.print(':');
        cas.concat(":");
        if (now.minute < 10)
        {
            Serial.print('0');
            cas.concat(String(0));
        }
        cas.concat(String(now.minute));
        Serial.print(now.minute); // 00-59
        Serial.print(':');

        if (now.second < 10)
        {
            Serial.print('0');
        }

        Serial.print(now.second); // 00-59

        Serial.println(cas);
    }
    P.displayText(cas.c_str(), PA_CENTER, 0, 0, PA_PRINT, PA_NO_EFFECT);
}

// void TimeApi() {
//
//    httpClient.get("/api/timezone/Europe/Prague");
//    String payload = httpClient.responseBody();
// DeserializationError error = deserializeJson(timeApi, payload.c_str());
//         if (error)
//         {
//           Serial.print(F("deserializeJson() failed: "));
//           Serial.println(error.f_str());
//           return;
//         }
//         const char *datetime = timeApi["datetime"]; // "2024-02-09T15:44:57.684805+01:00"
//         String datetimeStr = String(datetime);
//         int year = datetimeStr.substring(2, 4).toInt();  // "24"
//         int month = datetimeStr.substring(5, 7).toInt(); // "02"
//         int day = datetimeStr.substring(8, 10).toInt();  // "09"
//
//         int hours = datetimeStr.substring(11, 13).toInt();   // "15"
//         int minutes = datetimeStr.substring(14, 16).toInt(); // "44"
//         int seconds = datetimeStr.substring(17, 19).toInt(); // "57"
//         const char *dow = timeApi["day_of_week"];
//         int dowInt = String(dow).toInt(); // "3"
//         Serial.println(hours);
//                 httpClient.stop();
// }
//
// void WeatherApi() {
//     HttpClient httpClient = HttpClient(client, "http://api.openweathermap.org", 80);
//    httpClient.get("/data/2.5/weather?lat=49.3039&lon=14.1457&appid=c7751024e682e3d3ed614bf31ae6925f&units=metric&lang=cz");
//    String payload = httpClient.responseBody();
//     DeserializationError error = deserializeJson(temp, payload);
//         if (error)
//         {
//           Serial.print(F("deserializeJson() failed: "));
//           Serial.println(error.f_str());
//           return;
//         }
//
//         JsonObject weather_0 = temp["weather"][0];
//         const char *weather_0_description = weather_0["description"];
//         JsonObject main = temp["main"];
//         float main_temp = main["temp"];             // 11.58
//         float main_feels_like = main["feels_like"]; // 11.4
//         float main_temp_min = main["temp_min"];     // 11.36
//         float main_temp_max = main["temp_max"];     // 13.38
//         int main_pressure = main["pressure"];       // 994
//         int main_humidity = main["humidity"];       // 100
//         Serial.println(weather_0_description);
//         httpClient.stop();
// }

void printWifiData()
{
    // print your board's IP address:
    IPAddress ip = WiFi.localIP();
    Serial.print("IP Address: ");
    Serial.println(ip);
    Serial.println(ip);

    // print your MAC address:
    byte mac[6];
    WiFi.macAddress(mac);
    Serial.print("MAC address: ");
    printMacAddress(mac);
}

void printCurrentNet()
{
    // print the SSID of the network you're attached to:
    Serial.print("SSID: ");
    Serial.println(WiFi.SSID());

    // print the MAC address of the router you're attached to:
    byte bssid[6];
    WiFi.BSSID(bssid);
    Serial.print("BSSID: ");
    printMacAddress(bssid);

    // print the received signal strength:
    long rssi = WiFi.RSSI();
    Serial.print("signal strength (RSSI):");
    Serial.println(rssi);

    // print the encryption type:
    byte encryption = WiFi.encryptionType();
    Serial.print("Encryption Type:");
    Serial.println(encryption, HEX);
    Serial.println();
}

void printMacAddress(byte mac[])
{
    for (int i = 5; i >= 0; i--)
    {
        if (mac[i] < 16)
        {
            Serial.print("0");
        }
        Serial.print(mac[i], HEX);
        if (i > 0)
        {
            Serial.print(":");
        }
    }
    Serial.println();
}

//// Knihovny
// #include <LiquidCrystal_I2C.h>
// #include <BH1750.h>
//// #include <Ethernet2.h>
//// Teploměr a vlhkoměr DHT11
// #include "MQ135.h"
//// připojení knihovny DHT
// #include "DHT.h"
// #include <Wire.h>
// #include <ArduinoJson.h>
// #include <Adafruit_NeoPixel.h>
//// nastavení propojovacího pinu
// #define pinDIN 7
//// nastavení počtu LED modulů
// #define pocetLED 8
//// inicializace LED modulu z knihovny
// Adafruit_NeoPixel rgbWS = Adafruit_NeoPixel(pocetLED, pinDIN, NEO_GRB + NEO_KHZ800);
//
//// nastavení čísla pinu s připojeným DHT senzorem
// #define pinDHT1 2
// #define analogPin A1
// #define pinA A0
// #define pinD 4
// #define typDHT11 DHT11
//
// LiquidCrystal_I2C lcd(0x27, 20, 4);
// BH1750 luxSenzor;
// MQ135 senzorMQ = MQ135(pinA);
// DHT DHT1(pinDHT1, typDHT11);
//
// //EthernetServer server(80);
//
//// deklarace promenných
////
////
// int tep = 0;
// int vlh = 0;
// int lux = 0;
// int ppm = 0;
//
// int data[5];
// //const int buttonPin = 6;
// //byte mac[] = {
// //    0xDE, 0xAD, 0xBE, 0xEF, 0xFE, 0xED};
//    StaticJsonDocument<200> jsonDoc;
//
//
//
// long previousMillis = 10000;
//
// void nastavRGB(byte r, byte g, byte b, int cislo)
//{
//   // vytvoření proměnné pro ukládání barev
//   uint32_t barva;
//   // načtení barvy do proměnné
//   barva = rgbWS.Color(r, g, b);
//   // nastavení barvy pro danou LED diodu,
//   // číslo má pořadí od nuly
//   rgbWS.setPixelColor(cislo - 1, barva);
//   // aktualizace barev na všech modulech
//   rgbWS.show();
// }
//
// float vypocet(int value, int min, int max)
//{
//   float rozsah = max - min;
//   float zaklad = value - min;
//   float procenta = zaklad / rozsah;
//   return procenta;
// }
//
// void setup()
//{
//   Wire.begin();
//   luxSenzor.begin();
//   lcd.begin();
//   lcd.clear();
//   lcd.backlight();
//   // komunikace přes sériovou linku rychlostí 9600 baud
//   Serial.begin(9600);
//   // zapnutí komunikace s teploměrem DHT
//   DHT1.begin();
//   rgbWS.begin();
//   rgbWS.setBrightness(20);
//   pinMode(analogPin, INPUT);
//   pinMode(A2, OUTPUT);
//   // při nástupné hraně (log0->log1) se vykoná program prerus
// }
//


// void PuvodniArdu() {
//    Serial.println(millis());
//      Serial.println(previousMillis);
//
//
//      lcd.clear();
//
//      teplota(0, 1);
//      svitivost(2);
//           plyny(3);
//      ohinek();
//      jsonDoc["svitivost"] = data[0];
//      jsonDoc["plznz"] = data[1];
//      jsonDoc["teplota"] = data[2];
//      jsonDoc["humidity"] = data[3];
//
//      nastavRGB(255 * vypocet(data[2], 19, 33), 255 * (1 - vypocet(data[2], 19, 33)), 0, 1);
//      nastavRGB(255 * vypocet(data[3], 10, 65), 255 * (1 - vypocet(data[3], 10, 65)), 0, 2);
//      nastavRGB(255 * vypocet(data[1], 100, 800), 255 * (1 - vypocet(data[1], 100, 800)), 0, 3);
//      nastavRGB(255 * vypocet(data[0], 1, 2000), 255 * (1 - vypocet(data[0], 1, 2000)), 0, 4);
//      nastavRGB(255 * (1 - vypocet(data[4], 0, 2)), 255 * (vypocet(data[4], 0, 2)), 0, 5);
//      if (data[0] > 2000 || data[1] > 800 || data[2] > 33 || data[3] > 65 || data[5] != 2)
//      {
//        analogWrite(A2, 250);
//      }
//      String jsonString;
//      serializeJson(jsonDoc, jsonString);
//      Serial.println(jsonString);
//      previousMillis = millis();
//      delay(20);
// }
//
//
//  void loop()
//{
//    if ((millis() - previousMillis) > 10000)
//    {
//      Serial.println(millis());
//      Serial.println(previousMillis);
//
//
//      lcd.clear();
//
//      teplota(0, 1);
//      svitivost(2);
//           plyny(3);
//      ohinek();
//      jsonDoc["svitivost"] = data[0];
//      jsonDoc["plznz"] = data[1];
//      jsonDoc["teplota"] = data[2];
//      jsonDoc["humidity"] = data[3];
//
//      nastavRGB(255 * vypocet(data[2], 19, 33), 255 * (1 - vypocet(data[2], 19, 33)), 0, 1);
//      nastavRGB(255 * vypocet(data[3], 10, 65), 255 * (1 - vypocet(data[3], 10, 65)), 0, 2);
//      nastavRGB(255 * vypocet(data[1], 100, 800), 255 * (1 - vypocet(data[1], 100, 800)), 0, 3);
//      nastavRGB(255 * vypocet(data[0], 1, 2000), 255 * (1 - vypocet(data[0], 1, 2000)), 0, 4);
//      nastavRGB(255 * (1 - vypocet(data[4], 0, 2)), 255 * (vypocet(data[4], 0, 2)), 0, 5);
//      if (data[0] > 2000 || data[1] > 800 || data[2] > 33 || data[3] > 65 || data[5] != 2)
//      {
//        analogWrite(A2, 250);
//      }
//      String jsonString;
//      serializeJson(jsonDoc, jsonString);
//      Serial.println(jsonString);
//      previousMillis = millis();
//      delay(20);
//    }
//  }

// #include <Wire.h>
// #include <LiquidCrystal_I2C.h>
//
//// Set the LCD address to 0x27 for a 16 chars and 2 line display
// LiquidCrystal_I2C lcd(0x27, 20, 4);
//
// void setup()
//{
//  // initialize the LCD
//  lcd.begin();
//
//  // Turn on the blacklight and print a message.
//  lcd.backlight();
//  lcd.print(" world!");
// }
//
// void loop()
//{
//  // Do nothing here...
//
//// Arduino I2C skener
//// navody.dratek.cz
//
//// připojení potřebné knihovny
// #include <Wire.h>
//// nastavení čísel propojovacích pinů
// #define I2C_SDA 21
// #define I2C_SCL 22
//
// void setup() {
//   // zahájení komunikace po I2C sběrnici,
//   // lze použít buď výchozí piny s variantou ()
//   // nebo specifikovat piny např. u ESP desek (SDA, SCL)
//   Wire.begin();
//   //Wire.begin(I2C_SDA, I2C_SCL);
//
//   // zahájení komunikace po sériové lince
//   Serial.begin(9600);
//   Serial.println("Start I2C skeneru...");
// }
//
// void loop() {
//   // vytvoření pomocných proměnných
//   byte chyba, adresa;
//   int pocetZarizeni = 0;
//   Serial.println("Zacatek hledani...");
//   // smyčka pro hledání zařízení
//   // I2C zařízení mohou mít adresu 1-126
//   for (adresa = 1; adresa < 127; adresa++ ) {
//     // zahájení komunikace a jeho následné ukončení,
//     // při ukončení probíhá detekce zařízení pomocí
//     // kontroly návratové hodnoty
//     Wire.beginTransmission(adresa);
//     chyba = Wire.endTransmission();
//     // pokud nám zařízení odpoví '0',
//     // tak funguje správně
//     if (chyba == 0) {
//       // vytištění informací o zařízení včetně
//       // jeho adresy v hexa formátu
//       Serial.print("I2C zarizeni nalezeno na adrese 0x");
//       Serial.print(adresa, HEX);
//       Serial.println("  !");
//       // inkrementace počítadla zařízení
//       pocetZarizeni++;
//     }
//     // při chybě v komunikaci je chybný výstup 4
//     else if (chyba == 4) {
//       // vytištění informací o zařízení včetně
//       // jeho adresy v hexa formátu
//       Serial.print("Neznama chyba na adrese 0x");
//       Serial.println(adresa, HEX);
//     }
//   }
//   // kontrola počítadla zařízení
//   if (pocetZarizeni == 0) {
//     // nebylo nalezeno žádné zařízení, protože neproběhla inkrementace
//     Serial.println("Zadne I2C zarizeni nebylo nalezeno.");
//   }
//   else {
//     // oznámení o konci hledání
//     Serial.print("Konec hledani, nalezeno ");
//     Serial.print(pocetZarizeni);
//     Serial.println(" zarizeni.");
//   }
//   // pauza před novým během smyčky
//   delay(5000);
// }

// #include "DFRobotDFPlayerMini.h"
//
// DFRobotDFPlayerMini myDFPlayer;
// void printDetail(uint8_t type, int value);
// void setup()
//{ // put your setup code here, to run once:              // put your setup code here, to run once:
//     Serial2.begin(9600);
//     Serial.begin(115200);
//     Serial.println();
//     Serial.println(F("DFRobot DFPlayer Mini Demo"));
//     Serial.println(F("Initializing DFPlayer ... (May take 3~5 seconds)"));
//     if (!myDFPlayer.begin(Serial2))
//     { // Use softwareSerial to communicate with mp3.
//         Serial.println(F("Unable to begin:"));
//         Serial.println(F("1.Please recheck the connection!"));
//         Serial.println(F("2.Please insert the SD card!"));
//         while (true)
//             ;
//     }
//     Serial.println(F("DFPlayer Mini online."));
//     myDFPlayer.volume(4); // Set volume value. From 0 to 30
//     myDFPlayer.play(1);   // Play the first mp3
// }
//
// void loop()
//{
// }

// #include <MD_Parola.h>
// #include <MD_MAX72xx.h>
// #include <SPI.h>
//
//// Define the number of devices we have in the chain and the hardware interface
//// NOTE: These pin numbers will probably not work with your hardware and may
//// need to be adapted
// #define HARDWARE_TYPE MD_MAX72XX::FC16_HW
// #define MAX_DEVICES 4
//
// #define CLK_PIN   3
// #define DATA_PIN  5
// #define CS_PIN    4
//
// int test = 0;
//// Hardware SPI connection
////MD_Parola P = MD_Parola(HARDWARE_TYPE, CS_PIN, MAX_DEVICES);
//// Arbitrary output pins
// MD_Parola P = MD_Parola(HARDWARE_TYPE, DATA_PIN, CLK_PIN, CS_PIN, MAX_DEVICES);
//
// void setup(void)
//{
//   P.begin();
//
// }
//
// void loop(void)
//{
//  test++;
//  char lol = test;
//   P.write(lol);
//   delay(1000);
// }
//

void displaywidget(int code_no)
{
    if (200 <= code_no and code_no <= 202)
        display.drawBitmap(0, 0, thunderstorm_rain, 57, 56, BLACK, WHITE);
    else if (230 <= code_no and code_no <= 233)
        display.drawBitmap(0, 0, thunderstrom_drizzle, 57, 56, BLACK, WHITE);
    else if (300 <= code_no and code_no <= 302)
        display.drawBitmap(0, 0, drizzle, 57, 54, BLACK, WHITE);
    else if (500 <= code_no and code_no <= 522)
        display.drawBitmap(0, 0, rain, 57, 54, BLACK, WHITE);
    else if ((600 <= code_no and code_no <= 610) or (621 <= code_no and code_no <= 623))
        display.drawBitmap(0, 0, snow, 57, 54, BLACK, WHITE);
    else if (611 <= code_no and code_no <= 612)
        display.drawBitmap(0, 0, sleet, 57, 54, BLACK, WHITE);
    else if (700 <= code_no and code_no <= 751)
        display.drawBitmap(0, 0, mist, 57, 54, BLACK, WHITE);
    else if (801 <= code_no and code_no <= 804)
        display.drawBitmap(0, 0, cloudy, 57, 54, BLACK, WHITE);
    else if (code_no == 900)
        display.drawBitmap(0, 0, unknown_prep, 57, 54, BLACK, WHITE);
    else
        display.fillCircle(30, 30, 20, WHITE); // sunny day
}